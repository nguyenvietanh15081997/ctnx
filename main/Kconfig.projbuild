## main/Kconfig.projbuild
```kconfig
menu "Minihub Configuration"

    config ENABLE_LITTLEFS
        bool "Enable use Little FS"
        default y
        help
            Enable use Little FS

    config ENABLE_ZIGBEE
        bool "Enable ENABLE_ZIGBEE"
        default n
        help
            Can connect to ZIGBEE devices

    config ENABLE_BLE
        bool "Enable BLE feature"
        default y
        help
            Can connect to BLE devices

    config ENABLE_MQTT
        bool "Enable MQTT feature"
        default n
        help
            Can connect to MQTT devices
        
    config ENABLE_IR
        bool "Enable Ir feature"
        default n
        help
            Can connect to Ir devices

    config ENABLE_MODBUS
        bool "Enable MODBUS feature"
        default n
        help
            Can connect to Modbus devices
    config ENABLE_BLE_FAST_SCAN
        bool "Enable Ble fast scan feature"
        default n
        help
            Can connect to ble fast scan devices

    config ENABLE_MATTER
        bool "Enable matter feature"
        default n
        help
            Can connect to matter devices
endmenu
```
